## config/boards/shields/brandlilja/KConfig.shield
```kconfig
config SHIELD_BRANDLILJA_LEFT
    def_bool $(shields_list_contains,brandlilja_left)
    select SHIELD_BRANDLILJA_LEFT

config SHIELD_BRANDLILJA_RIGHT
    def_bool $(shields_list_contains,brandlilja_right)
    select SHIELD_BRANDLILJA_RIGHT
```

## config/boards/shields/brandlilja/Kconfig.defconfig
```kconfig
if SHIELD_BRANDLILJA_LEFT

config ZMK_KEYBOARD_NAME
    default "Brandlilja"

config ZMK_SPLIT_ROLE_CENTRAL
    default y

endif

if SHIELD_BRANDLILJA_LEFT || SHIELD_BRANDLILJA_RIGHT

config ZMK_SPLIT
    default y

endif
```

## config/west.yml
```yaml
manifest:
  remotes:
    - name: zmkfirmware
      url-base: https://github.com/zmkfirmware
  projects:
    - name: zmk
      remote: zmkfirmware
      revision: 308d6bce6eb338f387a454c7366d0bcb07463d7b
      import: app/west.yml
  self:
    path: config
```
